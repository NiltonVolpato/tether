## cpp/test_app/sdkconfig.defaults
```kconfig
CONFIG_IDF_TARGET="esp32"

# Extra checks, as ESP-IDF's own test apps use.
CONFIG_HEAP_POISONING_COMPREHENSIVE=y
CONFIG_COMPILER_STACK_CHECK_MODE_STRONG=y
CONFIG_COMPILER_STACK_CHECK=y
CONFIG_FREERTOS_WATCHPOINT_END_OF_STACK=y
CONFIG_BOOTLOADER_LOG_LEVEL_WARN=y

CONFIG_ESP_MAIN_TASK_STACK_SIZE=8192
CONFIG_LOG_MAXIMUM_LEVEL_DEBUG=y
```
